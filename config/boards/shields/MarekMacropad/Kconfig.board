## config/boards/shields/MarekMacropad/Kconfig.defconfig
```kconfig
if SHIELD_MAREKMACROPAD

config ZMK_KEYBOARD_NAME
    default "MarekMacropad"

endif

##########################
# ROT ENCODER

CONFIG_EC11=y
CONFIG_EC11_TRIGGER_GLOBAL_THREAD=y

##########################
# DISPLAY

if ZMK_DISPLAY

config I2C
    default y

config SSD1306
    default y

config SSD1306_REVERSE_MODE
    default y

endif # ZMK_DISPLAY
```

## config/boards/shields/MarekMacropad/Kconfig.shield
```kconfig
config SHIELD_MAREKMACROPAD
    def_bool $(shields_list_contains, MarekMacropad)
```
